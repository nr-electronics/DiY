/**
  ******************************************************************************
  * @file           : main.c
  * @brief          : Main program body
  ******************************************************************************
  ** This notice applies to any and all portions of this file
  * that are not between comment pairs USER CODE BEGIN and
  * USER CODE END. Other portions of this file, whether 
  * inserted by the user or by software development tools
  * are owned by their respective copyright owners.
  *
  * COPYRIGHT(c) 2018 STMicroelectronics
  *
  * Redistribution and use in source and binary forms, with or without modification,
  * are permitted provided that the following conditions are met:
  *   1. Redistributions of source code must retain the above copyright notice,
  *      this list of conditions and the following disclaimer.
  *   2. Redistributions in binary form must reproduce the above copyright notice,
  *      this list of conditions and the following disclaimer in the documentation
  *      and/or other materials provided with the distribution.
  *   3. Neither the name of STMicroelectronics nor the names of its contributors
  *      may be used to endorse or promote products derived from this software
  *      without specific prior written permission.
  *
  * THIS SOFTWARE IS PROVIDED BY THE COPYRIGHT HOLDERS AND CONTRIBUTORS "AS IS"
  * AND ANY EXPRESS OR IMPLIED WARRANTIES, INCLUDING, BUT NOT LIMITED TO, THE
  * IMPLIED WARRANTIES OF MERCHANTABILITY AND FITNESS FOR A PARTICULAR PURPOSE ARE
  * DISCLAIMED. IN NO EVENT SHALL THE COPYRIGHT HOLDER OR CONTRIBUTORS BE LIABLE
  * FOR ANY DIRECT, INDIRECT, INCIDENTAL, SPECIAL, EXEMPLARY, OR CONSEQUENTIAL
  * DAMAGES (INCLUDING, BUT NOT LIMITED TO, PROCUREMENT OF SUBSTITUTE GOODS OR
  * SERVICES; LOSS OF USE, DATA, OR PROFITS; OR BUSINESS INTERRUPTION) HOWEVER
  * CAUSED AND ON ANY THEORY OF LIABILITY, WHETHER IN CONTRACT, STRICT LIABILITY,
  * OR TORT (INCLUDING NEGLIGENCE OR OTHERWISE) ARISING IN ANY WAY OUT OF THE USE
  * OF THIS SOFTWARE, EVEN IF ADVISED OF THE POSSIBILITY OF SUCH DAMAGE.
  *
  ******************************************************************************
  */
/* Includes ------------------------------------------------------------------*/
#include "main.h"
#include "stm32f0xx_hal.h"

/* USER CODE BEGIN Includes */

/* USER CODE END Includes */

/* Private variables ---------------------------------------------------------*/
I2C_HandleTypeDef hi2c1;

/* USER CODE BEGIN PV */
/* Private variables ---------------------------------------------------------*/

#define OLED_adress 0x78
#define OLED_SETCONTRAST 0x81
#define OLED_DISPLAYALLON_RESUME 0xA4
#define OLED_DISPLAYALLON 0xA5
#define OLED_NORMALDISPLAY 0xA6
#define OLED_INVERTDISPLAY 0xA7
#define OLED_DISPLAYOFF 0xAE
#define OLED_DISPLAYON 0xAF
#define OLED_SETDISPLAYOFFSET 0xD3
#define OLED_SETCOMPINS 0xDA
#define OLED_SETVCOMDETECT 0xDB
#define OLED_SETDISPLAYCLOCKDIV 0xD5
#define OLED_SETPRECHARGE 0xD9
#define OLED_SETMULTIPLEX 0xA8
#define OLED_SETLOWCOLUMN 0x00
#define OLED_SETHIGHCOLUMN 0x10
#define OLED_SETSTARTLINE 0x40
#define OLED_MEMORYMODE 0x20
#define OLED_COLUMNADDR 0x21
#define OLED_PAGEADDR   0x22
#define OLED_COMSCANINC 0xC0
#define OLED_COMSCANDEC 0xC8
#define OLED_SEGREMAP 0xA0
#define OLED_CHARGEPUMP 0x8D
#define OLED_SWITCHCAPVCC 0x2
#define OLED_NOP 0xE3

#define OLED_WIDTH 128
#define OLED_HEIGHT 64
#define OLED_BUFFERSIZE (OLED_WIDTH*OLED_HEIGHT)/8
#define OLED_DEFAULT_SPACE 5

#define COMAND 0x00
#define DATA   0x40
uint16_t gg;
uint8_t temp[2] = {0,0};
uint8_t temp_char[7] = {0,0,0,0,0,0,0};
unsigned char LCD_X,LCD_Y;
unsigned char LCD_Buffer[0x0500] =
{
	0x00, 0x00, 0x00, 0x00, 0x00,// 00
	0x00, 0x00, 0x5F, 0x00, 0x00,// 01
	0x00, 0x07, 0x00, 0x07, 0x00,// 02
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	0x20, 0x10, 0x08, 0x04, 0x02,// AF
	//0x3E, 0x51, 0x49, 0x45, 0x3E,// B0
	0x00, 0x06, 0x09, 0x09, 0x06,
	0x00, 0x42, 0x7F, 0x40, 0x00,// B1
	0x42, 0x61, 0x51, 0x49, 0x46,// B2
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	0x48, 0x54, 0x34, 0x14, 0x7C // FF ?
};
/* USER CODE END PV */

/* Private function prototypes -----------------------------------------------*/
void SystemClock_Config(void);
static void MX_GPIO_Init(void);
static void MX_I2C1_Init(void);

/* USER CODE BEGIN PFP */
/* Private function prototypes -----------------------------------------------*/

void i2c_init(void);// ??????? ????????????? ???? TWI
void OLED_init(void);
//unsigned char OLED_write(unsigned char data);
void sendCommand(unsigned char command);
void LCD_Clear(void);
void LCD_Char(unsigned int c);
void LCD_Goto(unsigned char x, unsigned char y);
void LCD_DrawImage(unsigned char num_image);
void OLED_string(char *string);
void OLED_num_to_str(unsigned int value, unsigned char nDigit);


void sendCommand(uint8_t command_s)
{
	temp[0] = COMAND;
	temp[1] = command_s;
	HAL_I2C_Master_Transmit(&hi2c1,OLED_adress,temp,2,100);
}

void sendData(uint8_t data_s)
{
	temp[0] = DATA;
	temp[1] = data_s;
	HAL_I2C_Master_Transmit(&hi2c1,OLED_adress,temp,2,100);
}

void LCD_Goto(unsigned char x, unsigned char y)
{
	LCD_X = x;
	LCD_Y = y;
	sendCommand(0xB0 + y);
	sendCommand(x & 0xf);
	sendCommand(0x10 | (x >> 4));
}


void LCD_Clear(void)
{
	unsigned short i;
	unsigned short x=0;
	unsigned short y=0;
	LCD_Goto(0,0);

	for (i=0; i<(OLED_BUFFERSIZE); i++) //(SSD1306_LCDWIDTH*SSD1306_LCDHEIGHT/8)
	{
		LCD_Char(' ');
		x ++;
		if(x>OLED_WIDTH)
		{
			x =0;
			y++;
			LCD_Goto(0,y);
		}
	}
	LCD_X =OLED_DEFAULT_SPACE;
	LCD_Y =0;
}

void LCD_Char(unsigned int c)
{
	unsigned char x = 0;
	temp_char[0] = 0x40;
	for (x=0; x<5; x++)
	{
		temp_char[x+1] = LCD_Buffer[c*5+x];
	}
	temp_char[6] = 0;
	HAL_I2C_Master_Transmit(&hi2c1, OLED_adress, temp_char, 7,1000);

	LCD_X += 8;
	if(LCD_X>OLED_WIDTH)
	{
		LCD_X = OLED_DEFAULT_SPACE;
	}
}


void OLED_string(char *string)
{
	while(*string != '\0')
	{  
		LCD_Char(*string);
		string++;
	}
}

void OLED_num_to_str(unsigned int value, unsigned char nDigit)
{
	switch(nDigit)
	{
		case 5: LCD_Char(value/10000+48);
		case 4: LCD_Char((value/1000)%10+48);
		case 3: LCD_Char((value/100)%10+48);
		case 2: LCD_Char((value/10)%10+48);
		case 1: LCD_Char(value%10+48);
	}
}


void OLED_init(void)
{
		// Turn display off
		sendCommand(OLED_DISPLAYOFF);

		sendCommand(OLED_SETDISPLAYCLOCKDIV);
		sendCommand(0x80);

		sendCommand(OLED_SETMULTIPLEX);
		//sendCommand(0x1F);//128x32
		sendCommand(0x3F);//128x64
		
		sendCommand(OLED_SETDISPLAYOFFSET);
		sendCommand(0x00);
		
		sendCommand(OLED_SETSTARTLINE | 0x00);//0
		
		// We use internal charge pump
		sendCommand(OLED_CHARGEPUMP);
		sendCommand(0x14);
		
		// Horizontal memory mode
		sendCommand(OLED_MEMORYMODE);
		sendCommand(0x00);
		
		sendCommand(OLED_SEGREMAP | 0x1);

		sendCommand(OLED_COMSCANDEC);

		sendCommand(OLED_SETCOMPINS);
		//sendCommand(0x02);//128x32
		sendCommand(0x12);//128x64
		
		// Max contrast
		sendCommand(OLED_SETCONTRAST);
		//sendCommand(0x0F);//0xCF
		sendCommand(0xCF);//0xCF

		sendCommand(OLED_SETPRECHARGE);
		sendCommand(0xF1);

		sendCommand(OLED_SETVCOMDETECT);
		//sendCommand(0x10);//0x40
		sendCommand(0x40);//0x40

		sendCommand(OLED_DISPLAYALLON_RESUME);

		// Non-inverted display
		sendCommand(OLED_NORMALDISPLAY);

		// Turn display back on
		sendCommand(OLED_DISPLAYON);
}

/* USER CODE END PFP */

/* USER CODE BEGIN 0 */

/* USER CODE END 0 */

/**
  * @brief  The application entry point.
  *
  * @retval None
  */
int main(void)
{
  /* USER CODE BEGIN 1 */

  /* USER CODE END 1 */

  /* MCU Configuration----------------------------------------------------------*/

  /* Reset of all peripherals, Initializes the Flash interface and the Systick. */
  HAL_Init();

  /* USER CODE BEGIN Init */

  /* USER CODE END Init */

  /* Configure the system clock */
  SystemClock_Config();

  /* USER CODE BEGIN SysInit */

  /* USER CODE END SysInit */

  /* Initialize all configured peripherals */
  MX_GPIO_Init();
  MX_I2C1_Init();
  /* USER CODE BEGIN 2 */
	HAL_Delay(100);
	OLED_init();
	LCD_Clear();
	LCD_Goto(0,0);
	OLED_string("Hello from");
	LCD_Goto(0,1);
	OLED_string("NR.electronics");
	LCD_Goto(0,2);
	OLED_string("--------------");
	LCD_Goto(0,3);
	OLED_string("0,96 OLED LCD 128x64 ");
	

  /* USER CODE END 2 */

  /* Infinite loop */
  /* USER CODE BEGIN WHILE */
  while (1)
  {

  /* USER CODE END WHILE */

  /* USER CODE BEGIN 3 */
	LCD_Goto(50,5);
	OLED_num_to_str(gg--,5);
  
	HAL_Delay(1);
  }
  /* USER CODE END 3 */

}

/**
  * @brief System Clock Configuration
  * @retval None
  */
void SystemClock_Config(void)
{

  RCC_OscInitTypeDef RCC_OscInitStruct;
  RCC_ClkInitTypeDef RCC_ClkInitStruct;
  RCC_PeriphCLKInitTypeDef PeriphClkInit;

    /**Initializes the CPU, AHB and APB busses clocks 
    */
  RCC_OscInitStruct.OscillatorType = RCC_OSCILLATORTYPE_HSI;
  RCC_OscInitStruct.HSIState = RCC_HSI_ON;
  RCC_OscInitStruct.HSICalibrationValue = 16;
  RCC_OscInitStruct.PLL.PLLState = RCC_PLL_ON;
  RCC_OscInitStruct.PLL.PLLSource = RCC_PLLSOURCE_HSI;
  RCC_OscInitStruct.PLL.PLLMUL = RCC_PLL_MUL12;
  RCC_OscInitStruct.PLL.PREDIV = RCC_PREDIV_DIV1;
  if (HAL_RCC_OscConfig(&RCC_OscInitStruct) != HAL_OK)
  {
    _Error_Handler(__FILE__, __LINE__);
  }

    /**Initializes the CPU, AHB and APB busses clocks 
    */
  RCC_ClkInitStruct.ClockType = RCC_CLOCKTYPE_HCLK|RCC_CLOCKTYPE_SYSCLK
                              |RCC_CLOCKTYPE_PCLK1;
  RCC_ClkInitStruct.SYSCLKSource = RCC_SYSCLKSOURCE_PLLCLK;
  RCC_ClkInitStruct.AHBCLKDivider = RCC_SYSCLK_DIV1;
  RCC_ClkInitStruct.APB1CLKDivider = RCC_HCLK_DIV1;

  if (HAL_RCC_ClockConfig(&RCC_ClkInitStruct, FLASH_LATENCY_1) != HAL_OK)
  {
    _Error_Handler(__FILE__, __LINE__);
  }

  PeriphClkInit.PeriphClockSelection = RCC_PERIPHCLK_I2C1;
  PeriphClkInit.I2c1ClockSelection = RCC_I2C1CLKSOURCE_HSI;
  if (HAL_RCCEx_PeriphCLKConfig(&PeriphClkInit) != HAL_OK)
  {
    _Error_Handler(__FILE__, __LINE__);
  }

    /**Configure the Systick interrupt time 
    */
  HAL_SYSTICK_Config(HAL_RCC_GetHCLKFreq()/1000);

    /**Configure the Systick 
    */
  HAL_SYSTICK_CLKSourceConfig(SYSTICK_CLKSOURCE_HCLK);

  /* SysTick_IRQn interrupt configuration */
  HAL_NVIC_SetPriority(SysTick_IRQn, 0, 0);
}

/* I2C1 init function */
static void MX_I2C1_Init(void)
{

  hi2c1.Instance = I2C1;
  hi2c1.Init.Timing = 0x0000020B;
  hi2c1.Init.OwnAddress1 = 0;
  hi2c1.Init.AddressingMode = I2C_ADDRESSINGMODE_7BIT;
  hi2c1.Init.DualAddressMode = I2C_DUALADDRESS_DISABLE;
  hi2c1.Init.OwnAddress2 = 0;
  hi2c1.Init.OwnAddress2Masks = I2C_OA2_NOMASK;
  hi2c1.Init.GeneralCallMode = I2C_GENERALCALL_DISABLE;
  hi2c1.Init.NoStretchMode = I2C_NOSTRETCH_DISABLE;
  if (HAL_I2C_Init(&hi2c1) != HAL_OK)
  {
    _Error_Handler(__FILE__, __LINE__);
  }

    /**Configure Analogue filter 
    */
  if (HAL_I2CEx_ConfigAnalogFilter(&hi2c1, I2C_ANALOGFILTER_ENABLE) != HAL_OK)
  {
    _Error_Handler(__FILE__, __LINE__);
  }

    /**Configure Digital filter 
    */
  if (HAL_I2CEx_ConfigDigitalFilter(&hi2c1, 0) != HAL_OK)
  {
    _Error_Handler(__FILE__, __LINE__);
  }

}

/** Configure pins as 
        * Analog 
        * Input 
        * Output
        * EVENT_OUT
        * EXTI
*/
static void MX_GPIO_Init(void)
{

  /* GPIO Ports Clock Enable */
  __HAL_RCC_GPIOA_CLK_ENABLE();

}

/* USER CODE BEGIN 4 */

/* USER CODE END 4 */

/**
  * @brief  This function is executed in case of error occurrence.
  * @param  file: The file name as string.
  * @param  line: The line in file as a number.
  * @retval None
  */
void _Error_Handler(char *file, int line)
{
  /* USER CODE BEGIN Error_Handler_Debug */
  /* User can add his own implementation to report the HAL error return state */
  while(1)
  {
  }
  /* USER CODE END Error_Handler_Debug */
}

#ifdef  USE_FULL_ASSERT
/**
  * @brief  Reports the name of the source file and the source line number
  *         where the assert_param error has occurred.
  * @param  file: pointer to the source file name
  * @param  line: assert_param error line source number
  * @retval None
  */
void assert_failed(uint8_t* file, uint32_t line)
{ 
  /* USER CODE BEGIN 6 */
  /* User can add his own implementation to report the file name and line number,
     tex: printf("Wrong parameters value: file %s on line %d\r\n", file, line) */
  /* USER CODE END 6 */
}
#endif /* USE_FULL_ASSERT */

/**
  * @}
  */

/**
  * @}
  */

/************************ (C) COPYRIGHT STMicroelectronics *****END OF FILE****/
